## boards/sifli/eh-lb563/Kconfig.defconfig
```kconfig
# EH-LB563 Sifli HDK 563

# Copyright (c) 2025 Sifli Inc.
# SPDX-License-Identifier: Apache-2.0

if BOARD_SIFLI_EH_LB563
config BSP_USING_BOARD_EH_LB563XXX
    bool 
    default y
endif # BOARD_SIFLI_EH_LB563
```

## boards/sifli/eh-lb563/Kconfig.eh-lb563
```kconfig
# Copyright (c) 2016 BayLibre, SAS
# SPDX-License-Identifier: Apache-2.0

config BOARD_SIFLI_EH_LB563
	bool 
	default y
	select SOC_SF32LB563
	
```

## boards/sifli/eh-lb563/board.yml
```yaml
board:
  name: eh-lb563
  full_name: EH LB563
  vendor: sifli
  socs:
    - name: sf32lb563
```

## boards/sifli/em-lb525/Kconfig.defconfig
```kconfig
# EH-LB563 Sifli HDK 563

# Copyright (c) 2025 Sifli Inc.
# SPDX-License-Identifier: Apache-2.0

if BOARD_SIFLI_EM_LB525
config BSP_USING_BOARD_EM_LB525XXX
    bool 
    default y
endif # BOARD_SIFLI_EM_LB525
```

## boards/sifli/em-lb525/Kconfig.em-lb525
```kconfig
# Copyright (c) 2016 BayLibre, SAS
# SPDX-License-Identifier: Apache-2.0

config BOARD_SIFLI_EM_LB525
	bool 
	default y
	select SOC_SF32LB525
	
```

## boards/sifli/em-lb525/board.yml
```yaml
board:
  name: em-lb525
  full_name: EM LB525
  vendor: sifli
  socs:
    - name: sf32lb525
```

## boards/sifli/em-lb525/em-lb525_defconfig
```kconfig
# SPDX-License-Identifier: Apache-2.0

# enable uart driver
CONFIG_SERIAL=y

# enable GPIO
CONFIG_GPIO=y

CONFIG_PINCTRL=y

# console
CONFIG_CONSOLE=y
CONFIG_UART_CONSOLE=y

CONFIG_CLOCK_CONTROL=y

#enable MPU
CONFIG_ARM_MPU=y

# Enable HW stack protection
CONFIG_HW_STACK_PROTECTION=y

CONFIG_I2C=y

CONFIG_SYS_CLOCK_HW_CYCLES_PER_SEC=240000000
CONFIG_FLASH_LOAD_OFFSET=20000
CONFIG_MAIN_STACK_SIZE=2048
CONFIG_NOCACHE_MEMORY=y
CONFIG_BT_HCI_ACL_FLOW_CONTROL=n
```

## drivers/Kconfig
```kconfig
#
# SPDX-FileCopyrightText: 2025 SiFli Technologies(Nanjing) Co., Ltd
#
# SPDX-License-Identifier: Apache-2.0


menu "Drivers"

rsource "clock_control/Kconfig"
rsource "gpio/Kconfig"
rsource "pinctrl/Kconfig"
rsource "serial/Kconfig"

endmenu
```

## drivers/clock_control/Kconfig
```kconfig
#
# SPDX-FileCopyrightText: 2025 SiFli Technologies(Nanjing) Co., Ltd
#
# SPDX-License-Identifier: Apache-2.0

if CLOCK_CONTROL

module = CLOCK_CONTROL
module-str = clock control
source "subsys/logging/Kconfig.template.log_config"

rsource "./Kconfig.*"

endif # CLOCK_CONTROL
```

## drivers/clock_control/Kconfig.sf32lb
```kconfig
#
# SPDX-FileCopyrightText: 2025 SiFli Technologies(Nanjing) Co., Ltd
#
# SPDX-License-Identifier: Apache-2.0

config CLOCK_CONTROL_SF32LB
	bool "SF32LB Clock Control"
	default y
	depends on DT_HAS_SIFLI_SF32LB_RCC_ENABLED
	help
	  Enable support for SF32LB clock control driver.

config SF32LB_CLOCK_HSE_FREQ
	int "HSE clock frequency"
	default 32000000
	depends on CLOCK_CONTROL_SF32LB
	help
	  HSE clock frequency in Hz. This is the external high-speed
	  oscillator frequency.

config SF32LB_CLOCK_HSI_FREQ
	int "HSI clock frequency"
	default 16000000
	depends on CLOCK_CONTROL_SF32LB
	help
	  HSI clock frequency in Hz. This is the internal high-speed
	  oscillator frequency.
```

## drivers/entropy/Kconfig
```kconfig
# Copyright (c) 2025, Qingsong Gou <gouqs@hotmail.com>
# SPDX-License-Identifier: Apache-2.0

if ENTROPY_GENERATOR

module = ENTROPY
module-str = entropy
source "subsys/logging/Kconfig.template.log_config"

rsource "./Kconfig.*"

endif
```

## drivers/entropy/Kconfig.sf32lb
```kconfig
config ENTROPY_SF32LB
	bool "SF32LB Entropy driver"
	default y
	depends on DT_HAS_SIFLI_SF32LB_RNG_ENABLED
	select ENTROPY_HAS_DRIVER
	help
	  Enable driver for SF32LB True Random Number Generator (TRNG).
```

## drivers/flash/Kconfig
```kconfig
# Copyright (c) 2025, Qingsong Gou <gouqs@hotmail.com>
# SPDX-License-Identifier: Apache-2.0

if FLASH

module = FLASH
module-str = flash
source "subsys/logging/Kconfig.template.log_config"

rsource "./Kconfig.*"

endif # FLASH
```

## drivers/flash/Kconfig.sf32lb
```kconfig
# Copyright (c) 2025, Qingsong Gou <gouqs@hotmail.com>
# SPDX-License-Identifier: Apache-2.0

config SOC_FLASH_SF32LB
	bool "SF32LB flash driver"
	default y
	depends on FLASH
	select FLASH_HAS_PAGE_LAYOUT
	select FLASH_HAS_DRIVER_ENABLED
	help
	  Enables SF32LB Flash driver.
```

## drivers/gpio/Kconfig
```kconfig
# Copyright (c) 2025, Qingsong Gou <gouqs@hotmail.com>
# SPDX-License-Identifier: Apache-2.0

if GPIO

module = GPIO
module-str = gpio
source "subsys/logging/Kconfig.template.log_config"

rsource "./Kconfig.*"

endif # GPIO
```

## drivers/gpio/Kconfig.sf32lb
```kconfig
#
# SPDX-FileCopyrightText: 2025 SiFli Technologies(Nanjing) Co., Ltd
#
# SPDX-License-Identifier: Apache-2.0


config GPIO_SF32LB
	bool "GPIO driver for SF32LB family of MCUs"
	default y
	depends on DT_HAS_SIFLI_SF32LB_GPIO_ENABLED
	help
	  Enable GPIO driver for SF32LB series of MCUs
```

## drivers/i2c/Kconfig
```kconfig
# SPDX-FileCopyrightText: 2025 SiFli Technologies(Nanjing) Co., Ltd
# SPDX-License-Identifier: Apache-2.0

if I2C

module = I2C
module-str = i2c
source "subsys/logging/Kconfig.template.log_config"

rsource "./Kconfig.*"

endif # I2C
```

## drivers/i2c/Kconfig.sf32lb
```kconfig
# SPDX-FileCopyrightText: 2025 SiFli Technologies(Nanjing) Co., Ltd
# SPDX-License-Identifier: Apache-2.0

config I2C_SF32LB
	bool "SF32LB I2C instance"
	default y
	depends on DT_HAS_SIFLI_SF32LB_I2C_ENABLED
	help
	  Enable I2C instance on SF32LB chips.
```

## drivers/pinctrl/Kconfig
```kconfig
#
# SPDX-FileCopyrightText: 2025 SiFli Technologies(Nanjing) Co., Ltd
#
# SPDX-License-Identifier: Apache-2.0

if PINCTRL

module = PINCTRL
module-str = PINCTRL
source "subsys/logging/Kconfig.template.log_config"

rsource "./Kconfig.*"

endif # PINCTRL
```

## drivers/pinctrl/Kconfig.sf32lb
```kconfig
#
# SPDX-FileCopyrightText: 2025 SiFli Technologies(Nanjing) Co., Ltd
#
# SPDX-License-Identifier: Apache-2.0

config PINCTRL_SF32LB
	bool "PINCTRL Driver for SF32LB family of MCUs"
	default y
	depends on DT_HAS_SIFLI_SF32LB_PINCTRL_ENABLED
	help
	  Enable PINCTRL driver for SF32LB series of MCUs
```

## drivers/serial/Kconfig
```kconfig
# SPDX-FileCopyrightText: 2025 SiFli Technologies(Nanjing) Co., Ltd
# SPDX-License-Identifier: Apache-2

if SERIAL

module = UART
module-str = uart
source "subsys/logging/Kconfig.template.log_config"

rsource "./Kconfig.*"

endif # SERIAL
```

## drivers/serial/Kconfig.sf32lb
```kconfig
# SPDX-FileCopyrightText: 2025 SiFli Technologies(Nanjing) Co., Ltd
# SPDX-License-Identifier: Apache-2

config UART_SF32LB
	bool "SiFli SF32LB UART driver"
	default y
	depends on DT_HAS_SIFLI_SF32LB_UART_ENABLED
	select SERIAL_HAS_DRIVER
	select SERIAL_SUPPORT_INTERRUPT
	help
	  This option enables the SiFli SF32LB UART driver.
```

## dts/bindings/clock/sifli,pll-clock.yaml
```yaml
description: SiFli SF32LB Clock Controller

compatible: "sifli,pll-clock"

include: base.yaml
```

## dts/bindings/clock/sifli,rcc.yaml
```yaml
description: SiFli SF32LB Reset and Clock Control (RCC)

compatible: "sifli,rcc"

include: [clock-controller.yaml, base.yaml]

properties:
  reg:
    required: true
    description: RCC register map

  clock-frequency:
    required: true
    type: int

  ahb-prescaler:
    required: true
    type: int

  apb1-prescaler:
    required: true
    type: int

  apb2-prescaler:
    required: true
    type: int

  "#clock-cells":
    const: 1
    description: |
      Number of cells in a clock specifier. Must be 1. The cell is the clock
      subsystem identifier.

clock-cells:
  - id
```

## dts/bindings/clock/sifli,sf32lb-hxt-clock.yaml
```yaml
#
# SPDX-FileCopyrightText: 2025 SiFli Technologies(Nanjing) Co., Ltd
#
# SPDX-License-Identifier: Apache-2.0

description: SF32LB HXT Clock

compatible: "sifli,sf32lb-hxt-clock"

include: [fixed-clock.yaml]
```
