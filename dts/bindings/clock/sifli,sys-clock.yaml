## dts/bindings/clock/sifli,sys-clock.yaml
```yaml
# Copyright (c) Qingsong Gou <gouqs@hotmail.com>
# SPDX-License-Identifier: Apache-2.0

description: SF32LB Sys Clock

compatible: "sifli,sys-clock"

properties:
  hdiv:
    type: int
    required: true
    description: xxxx

  pdiv1:
    type: int
    required: true
    description: xxxx

  pdiv2:
    type: int
    required: true
    description: xxxx
```

## dts/bindings/gpio/sifli,sf32lb-gpio.yaml
```yaml
#
# SPDX-FileCopyrightText: 2025 SiFli Technologies(Nanjing) Co., Ltd
#
# SPDX-License-Identifier: Apache-2.0

description: SiFli GPIO controller

compatible: "sifli,sf32lb-gpio"

include: [gpio-controller.yaml, base.yaml]

properties:
  reg:
    required: true

  interrupts:
    required: true

  "#gpio-cells":
    const: 2

gpio-cells:
  - pin
  - flags
```

## dts/bindings/i2c/sifli,i2c.yaml
```yaml
# Copyright (c) 2025, Qingsong Gou <gouqs@hotmail.com>
# SPDX-License-Identifier: Apache-2.0

description: Sifli SF32LB I2C controller

compatible: "sifli,i2c"

include: [i2c-controller.yaml, pinctrl-device.yaml]

properties:
  reg:
    required: true

  clock-frequency:
    required: true
    description: Desired I2C bus clock frequency in Hz.
  #interrupts:
  #  required: true


  pinctrl-0:
    required: true

  pinctrl-names:
    required: true

# Example node in a board's .dts or .dtsi file:
# i2c0:
#   compatible = "sifli,i2c";
#   reg = <0xXXXX XXXX>; // Replace with actual base address and size
#   interrupts = <XXXX XX>; // Replace with actual IRQ and flags
#   clocks = <&XXXX XXXX>; // Replace with actual clock phandle and ID
#   status = "disabled"; // Change to "okay" to enable
```

## dts/bindings/input/focaltech,ft6146.yaml
```yaml
description: FocalTech FT6146 capacitive touch controller

compatible: "focaltech,ft6146"

include: i2c-device.yaml

properties:
  reg:
    required: true
    description: I2C address of the FT6146 (typically 0x38)

  int-gpios:
    type: phandle-array
    required: false
    description: Interrupt GPIO specification, active low

  reset-gpios:
    type: phandle-array
    required: false
    description: Reset GPIO specification, active low
```

## dts/bindings/pinctrl/sifli,sf32lb-pinctrl.yaml
```yaml
# Copyright (c) 2025 Qingsong Gou <gouqs@hotmail.com>
# SPDX-License-Identifier: Apache-2.0

description: |
  SiFli SF32LB pin controller Node
  Based on pincfg-node.yaml binding

  For example, setting pins PA27 and PA20 used as uart would look like this:

    #include <dt-bindings/pinctrl/sflb32-pinctrl.h>


    &pinctrl {
      uart1_default: uart0_default {
        group1 {
          pinmux = <SF32LB_PINMUX(PAD_PA27, PA27_I2C_UART)>;
          output-high;
        };
        group2 {
          pinmux = <SF32LB_PINMUX(PAD_PA20, PA20_I2C_UART)>;
          input-enable;
        };
      };

compatible: "sifli,sf32lb-pinctrl"

include: base.yaml

child-binding:
  description: |
    This binding gives a base representation of the SiFli SFLB32 pins
    configuration.
  child-binding:
    description:
      SiFli SFLB32 pin controller pin configuration group.

    include:
      - name: pincfg-node.yaml
        property-allowlist:
          - bias-disable
          - bias-pull-down
          - bias-pull-up
          - drive-push-pull
          - drive-open-drain
          - input-enable
          - output-enable
          - output-high
          - output-low

    properties:
      pinmux:
        required: true
        type: array
        description: |
          SiFli SFLB32 pin's configuration (pin, IO function).
```

## dts/bindings/rng/sifli,sf32lb-rng.yaml
```yaml
description: Sifli SF32LB True Random Number Generator

compatible: "sifli,sf32lb-rng"

include: base.yaml

properties:
  reg:
    description: Register space for the RNG peripheral
    required: true

  interrupts:
    required: true

  clocks:
    description: Clock source for the RNG peripheral
    required: true
```

## dts/bindings/rtc/sifli,sf32lb-rtc.yaml
```yaml
description: SiFli SF32LB RTC controller

compatible: "sifli,sf32lb-rtc"

include: base.yaml

properties:
  reg:
    required: true

  interrupts:
    required: true
```

## dts/bindings/serial/sifli,sf32lb-uart.yaml
```yaml
description: SiFli SF32LB USART UART

compatible: "sifli,sf32lb-uart"

include: [uart-controller.yaml, pinctrl-device.yaml]

properties:
  reg:
    required: true

  interrupts:
    required: true

  clocks:
    required: true

  pinctrl-0:
    required: true

  pinctrl-names:
    required: true

  current-speed:
    description: |
      Initial baud rate setting for UART. Defaults to baudrate of 1000000 if not specified.
    default: 1000000

  stop-bits:
    description: |
      Sets the number of stop bits. Defaults to standard of 1 if not specified.
    default: "1"

  data-bits:
    description: |
      Sets the number of data bits. Defaults to standard of 8 if not specified.
    default: 8
```

## dts/bindings/serial/sifli,uart.yaml
```yaml
description: SiFli USART UART

compatible: "sifli,uart"

include: [uart-controller.yaml]

properties:
  reg:
    required: true

  interrupts:
    required: true

  current-speed:
    description: |
      Initial baud rate setting for UART. Defaults to standard baudrate of 115200 if not specified.
    default: 1000000

  stop-bits:
    description: |
      Sets the number of stop bits. Defaults to standard of 1 if not specified.
    default: "1"

  data-bits:
    description: |
      Sets the number of data bits. Defaults to standard of 8 if not specified.
    default: 8
```

## soc/sifli/Kconfig
```kconfig
# Copyright (c) 2024 SiFli
# SPDX-License-Identifier: Apache-2.0

config SOC_FAMILY_SF32LB
    bool
	select HAS_SEGGER_RTT if ZEPHYR_SEGGER_MODULE
	select BUILD_OUTPUT_HEX

if SOC_FAMILY_SF32LB

rsource "*/Kconfig"

endif # SOC_FAMILY_SF32LB
```

## soc/sifli/Kconfig.defconfig
```kconfig
# SiFli SF32LB56X all MCU lines

# Copyright (c) 2017, I-SENSE group of ICCS
# SPDX-License-Identifier: Apache-2.0

# Default configurations appplied tp the whole SF32LB56X family

if SOC_FAMILY_SF32LB

# Source series Kconfig files first, so SoCs
# can override the defaults given here
rsource "*/Kconfig.defconfig"
endif # SOC_FAMILY_SF32LB
```

## soc/sifli/Kconfig.soc
```kconfig
# SPDX-FileCopyrightText: 2025 SiFli Technologies(Nanjing) Co., Ltd
# SPDX-License-Identifier: Apache-2.0

config SOC_FAMILY_SF32LB
	bool

#config CODE_DATA_RELOCATION_SRAM
#    bool
#    default y

config SOC_FAMILY
	default "sf32lb" if SOC_FAMILY_SF32LB

rsource "*/Kconfig.soc"
```

## soc/sifli/sf32lb52x/Kconfig.defconfig
```kconfig
# SiFli SF32LB52X

# Copyright (c) 2016 Open-RnD Sp. z o.o.
# Copyright (c) 2016 BayLibre, SAS
# SPDX-License-Identifier: Apache-2.0

# Kconfig symbols common to SF32LB52X series

if SOC_SERIES_SF32LB52X

rsource "Kconfig.defconfig.sf32lb52*"

endif # SOC_SERIES_SF32LB52X
```

## soc/sifli/sf32lb52x/Kconfig.defconfig.sf32lb523
```kconfig
# SiFli SF32LB525

# Copyright (c) 2016 Open-RnD Sp. z o.o.
# Copyright (c) 2016 BayLibre, SAS
# Copyright (c) 2019 Centaur Analytics, Inc
# Copyright (c) 2022 Tomislav Milkovic
# SPDX-License-Identifier: Apache-2.0

if SOC_SF32LB525
config NUM_IRQS
	default 98
endif # SOC_SF32LB525
```

## soc/sifli/sf32lb52x/Kconfig.soc
```kconfig
# SiFli SF32LB52X MCU line

# Copyright (c) 2016 Open-RnD Sp. z o.o.
# Copyright (c) 2016 BayLibre, SAS
# Copyright (c) 2019 Centaur Analytics, Inc
# Copyright (c) 2019 STMicroelectronics
# SPDX-License-Identifier: Apache-2.0

config SOC_SERIES_SF32LB52X
	bool
	select SOC_FAMILY_SF32LB

config SOC_SERIES
	default "sf32lb52x" if SOC_SERIES_SF32LB52X

config SOC_SF32LB520
	bool
	select SOC_SERIES_SF32LB52X

config SOC_SF32LB523
	bool
	select SOC_SERIES_SF32LB52X

config SOC_SF32LB525
	bool
	select SOC_SERIES_SF32LB52X

config SOC_SF32LB527
	bool
	select SOC_SERIES_SF32LB52X

config SOC
	default "sf32lb520" if SOC_SF32LB520
	default "sf32lb523" if SOC_SF32LB523
	default "sf32lb525" if SOC_SF32LB525
	default "sf32lb527" if SOC_SF32LB527
```

## soc/sifli/sf32lb56x/Kconfig
```kconfig
# SiFli 56X

# Copyright (c) 2016 Open-RnD Sp. z o.o.
# Copyright (c) 2016 BayLibre, SAS
# SPDX-License-Identifier: Apache-2.0

config SOC_SERIES_SF32LB56X
	select ARM
  	select ARM_MPU
	select ARMV8_M_DSP
    select ARMV7_M_ARMV8_M_MAINLINE
    select CPU_HAS_ICACHE
    select CPU_HAS_DCACHE
    select CPU_HAS_ARM_MPU    
	select CPU_CORTEX_M33
	select CPU_CORTEX_M_HAS_DWT
	select CPU_HAS_FPU
	select HAS_SWO
	select HAS_PM
	select HAS_POWEROFF
	select SOC_EARLY_INIT_HOOK
    select FLASH_HAS_DRIVER_ENABLED
	select FLASH_HAS_PAGE_LAYOUT
```

## soc/sifli/sf32lb56x/Kconfig.defconfig.sf32lb563
```kconfig
# SiFli SF32LB563

# Copyright (c) 2016 Open-RnD Sp. z o.o.
# Copyright (c) 2016 BayLibre, SAS
# Copyright (c) 2019 Centaur Analytics, Inc
# Copyright (c) 2022 Tomislav Milkovic
# SPDX-License-Identifier: Apache-2.0

if SOC_SF32LB563
config NUM_IRQS
	default 98
endif # SOC_SF32LB563
```

## soc/sifli/sf32lb56x/Kconfig.soc
```kconfig
# SiFli SF32LB56X MCU line

# Copyright (c) 2016 Open-RnD Sp. z o.o.
# Copyright (c) 2016 BayLibre, SAS
# Copyright (c) 2019 Centaur Analytics, Inc
# Copyright (c) 2019 STMicroelectronics
# SPDX-License-Identifier: Apache-2.0

config SOC_SERIES_SF32LB56X
	bool
	select SOC_FAMILY_SF32LB

config SOC_SERIES
	default "sf32lb56x" if SOC_SERIES_SF32LB56X

config SOC_SF32LB561
	bool
	select SOC_SERIES_SF32LB56X
config SOC_SF32LB563
	bool
	select SOC_SERIES_SF32LB56X
config SOC_SF32LB566
	bool
	select SOC_SERIES_SF32LB56X
config SOC_SF32LB567
	bool
	select SOC_SERIES_SF32LB56X
    
config SOC
	default "sf32lb561" if SOC_SF32LB561
	default "sf32lb563" if SOC_SF32LB563
	default "sf32lb565" if SOC_SF32LB566
	default "sf32lb567" if SOC_SF32LB567
```

## west.yml
```yaml
manifest:
  version: "1.2"
  remotes:
    - name: zephyrproject-rtos
      url-base: https://github.com/zephyrproject-rtos

  defaults:
    remote: zephyrproject-rtos

  projects:
    - name: zephyr
      revision: v4.1.0
      clone-depth: 1
      west-commands: scripts/west-commands.yml
      import:
        name-allowlist:
          - cmsis
          - cmsis-dsp
          - cmsis-nn
          - picolibc
  self:
    path: modules/hal/sifli
```
